## CMakeLists.txt
```
cmake_minimum_required(VERSION 3.20.0)
find_package(Zephyr REQUIRED HINTS $ENV{ZEPHYR_BASE})
project(ir_project)

# C++ 支持
set(CMAKE_CXX_STANDARD 11)
set(CMAKE_CXX_STANDARD_REQUIRED ON)
set(CMAKE_CXX_FLAGS "${CMAKE_CXX_FLAGS} -fno-rtti -fno-exceptions")

# 核心源文件
target_sources(app PRIVATE
    src/main.cpp
    # src/driver/ZephyrIRReceiver.cpp
    # src/driver/ZephyrIRSender.cpp
    # src/protocols/ir_Panasonic.cpp
    src/protocols/ir_Haier.cpp
    src/driver/IRsend.cpp
    src/driver/IRutils.cpp
    # src/driver/IRrecv.cpp
    src/driver/ir_hal.c
)
target_include_directories(app PRIVATE src/shim
    src/driver
    src/protocols
)

# get_property(TOOLCHAIN_INC GLOBAL PROPERTY TOOLCHAIN_C_STANDARD_INCLUDE_DIRS)
```

## prj.conf
```kconfig
# 启用 C++
# 启用 C++ 支持
CONFIG_CPP=y

# 如果需要 C++ 标准库支持
CONFIG_GLIBCXX_LIBCPP=y
# CONFIG_CPLUSPLUS=y

# 如果需要异常处理（通常不建议在嵌入式系统中使用）
# CONFIG_EXCEPTIONS=y

# 启用 GPIO 和 PWM
CONFIG_GPIO=y
# CONFIG_PWM=y
CONFIG_PWM_NRFX=y

# 增加堆栈大小，复杂的空调协议编解码可能需要较大栈
CONFIG_MAIN_STACK_SIZE=4096
CONFIG_HEAP_MEM_POOL_SIZE=4096

# 浮点数支持（部分协议计算需要）
CONFIG_CBPRINTF_FP_SUPPORT=y

# CONFIG_NRFX_PWM=y
# CONFIG_NRFX_TIMER=y
CONFIG_NRFX_GPPI=y
# CONFIG_GPIO=y
CONFIG_LOG=y
CONFIG_LOG_DEFAULT_LEVEL=2
# CONFIG_MAIN_STACK_SIZE=2048



# --- TIMER ---
CONFIG_NRFX_TIMER1=y

# --- PWM ---
CONFIG_NRFX_PWM0=y

# --- PPI ---
# CONFIG_NRFX_PPI=y

# --- Zephyr PWM framework ---
# 必须开启，否则 PWM_NRFX 依赖不满足
# CONFIG_PWM=y
```

## src/main.cpp
```c
#include "shim/Arduino.h"
#include <IRsend.h>
// #include <ir_Panasonic.h> // 包含格力空调协议头文件
#include <ir_Haier.h> // 包含海尔空调协议头文件
#include <zephyr/kernel.h>

// #include "IRsendNRF52.h"
// IRsendNRF52 irsend;

// 定义 GPIO 引脚号 (这里的数字仅用于 Shim 层 pinMode 占位，实际 PWM 在 driver
// 中处理)
const uint16_t kIrLed = 4;

// 实例化对象
IRsend irsend(kIrLed);
IRHaierAC ac(kIrLed); // 实例化松下空调对象

int main(void) {
  printk("Starting IR Remote for nRF52840...\n");

  // 初始化
  //   irsend.begin();
  ac.begin();

  // 设置空调参数
  printk("Setting up AC...\n");
  // ac.on();
  ac.setMode(kHaierAcCool);
  ac.setTemp(26);
  ac.setFan(kHaierAcFanLow);
  // ac.setSwingVertical(kHaierAcSwingVAuto);

  while (1) {
    printk("Sending IR Code: Cool 26C\n");

    // 发送！
    // ac.send() 内部会调用 irsend.sendRaw() 或 sendGeneric()
    // 最终会调用我们重写的 irsend.mark() / space()
    ac.send();

    k_sleep(K_SECONDS(5));
  }
  return 0;
}
```
